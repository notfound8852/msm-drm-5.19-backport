## msm/Kconfig
```kconfig
# SPDX-License-Identifier: GPL-2.0-only

config DRM_MSM
    tristate "MSM DRM"
    depends on DRM
    depends on ARCH_QCOM || SOC_IMX5 || (ARM && COMPILE_TEST)
    depends on OF && COMMON_CLK
    depends on MMU
    depends on INTERCONNECT || !INTERCONNECT
    select QCOM_MDT_LOADER if ARCH_QCOM
    select REGULATOR
    select DRM_KMS_HELPER
    select DRM_PANEL
    select SHMEM
    select TMPFS
    select QCOM_SCM if ARCH_QCOM
    select QCOM_COMMAND_DB if ARCH_QCOM
    select WANT_DEV_COREDUMP
    select SND_SOC_HDMI_CODEC if SND_SOC
    select SYNC_FILE
    select PM_OPP
    select IOMMU_IO_PGTABLE if !DRM_MSM_IS_DOWNSTREAM
    select DRM_CLIENT_SELECTION if !DRM_MSM_IS_DOWNSTREAM
    select DRM_DISPLAY_DP_AUX_BUS if !DRM_MSM_IS_DOWNSTREAM
    select DRM_DISPLAY_DP_HELPER if !DRM_MSM_IS_DOWNSTREAM
    select DRM_DISPLAY_HELPER if !DRM_MSM_IS_DOWNSTREAM
    select DRM_BRIDGE_CONNECTOR if !DRM_MSM_IS_DOWNSTREAM
    select DRM_EXEC if !DRM_MSM_IS_DOWNSTREAM
    select DRM_BRIDGE if !DRM_MSM_IS_DOWNSTREAM
    select DRM_PANEL_BRIDGE if !DRM_MSM_IS_DOWNSTREAM
    select DRM_SCHED if !DRM_MSM_IS_DOWNSTREAM
    select FB_SYSMEM_HELPERS if DRM_FBDEV_EMULATION && !DRM_MSM_IS_DOWNSTREAM
    select PM_GENERIC_DOMAINS if !DRM_MSM_IS_DOWNSTREAM
    select TRACE_GPU_MEM if !DRM_MSM_IS_DOWNSTREAM
    select NVMEM if !DRM_MSM_IS_DOWNSTREAM
    help
      DRM/KMS driver for MSM/snapdragon.

config DRM_MSM_GPU_STATE
	bool
	depends on DRM_MSM && (DEBUG_FS || DEV_COREDUMP)
	default y

config DRM_MSM_GPU_SUDO
	bool "Enable SUDO flag on submits"
	depends on DRM_MSM && EXPERT
	default y
	help
	  Enable userspace that has CAP_SYS_RAWIO to submit GPU commands
	  that are run from RB instead of IB1.  This essentially gives
	  userspace kernel level access, but is useful for firmware
	  debugging.

	  Only use this if you are a driver developer.  This should *not*
	  be enabled for production kernels.  If unsure, say N.

config DRM_MSM_IS_DOWNSTREAM
    bool "Enable support for downstream kernels"
    depends on DRM_MSM
    default y
    help
      If your kernel version lacks, modern interconnects, opp_tables,
      newer devm_clk implementations and new pixel_blend features that
      >=5.17 has, enable this! Otherwise ignore it.

      Please refer to drivers/gpu/drm/msm/shims/NOTE.md to read the 
      changes and a brief guide on how to add the missing pixel blending 
      features to your DRM core.

config DRM_MSM_MDSS
	bool
	depends on DRM_MSM
	default n

config DRM_MSM_MDP4
	bool "Enable MDP4 support in MSM DRM driver"
	depends on DRM_MSM
	default y
	help
	  Compile in support for the Mobile Display Processor v4 (MDP4) in
	  the MSM DRM driver. It is the older display controller found in
	  devices using APQ8064/MSM8960/MSM8x60 platforms.

config DRM_MSM_MDP5
	bool "Enable MDP5 support in MSM DRM driver"
	depends on DRM_MSM
	select DRM_MSM_MDSS
	default y
	help
	  Compile in support for the Mobile Display Processor v5 (MDP5) in
	  the MSM DRM driver. It is the display controller found in devices
	  using e.g. APQ8016/MSM8916/APQ8096/MSM8996/MSM8974/SDM6x0 platforms.

config DRM_MSM_DPU
	bool "Enable DPU support in MSM DRM driver"
	depends on DRM_MSM
	select DRM_MSM_MDSS
	default y
	help
	  Compile in support for the Display Processing Unit in
	  the MSM DRM driver. It is the display controller found in devices
	  using e.g. SDM845 and newer platforms.

config DRM_MSM_DP
	bool "Enable DisplayPort support in MSM DRM driver"
	depends on DRM_MSM
	select RATIONAL
	default y
	help
	  Compile in support for DP driver in MSM DRM driver. DP external
	  display support is enabled through this config option. It can
	  be primary or secondary display on device.

config CONFIG_DEBUG_DP
    bool "Enable DisplayPort debugging support in MSM DRM driver"
    depends on DRM_MSM
    select DRM_MSM_DP
    default n
    help
      Compile debugfs support for DP driver in MSM DRM driver.

config DRM_MSM_DSI
	bool "Enable DSI support in MSM DRM driver"
	depends on DRM_MSM
	select DRM_PANEL
	select DRM_MIPI_DSI
	default y
	help
	  Choose this option if you have a need for MIPI DSI connector
	  support.

config DRM_MSM_DSI_28NM_PHY
	bool "Enable DSI 28nm PHY driver in MSM DRM"
	depends on DRM_MSM_DSI
	default y
	help
	  Choose this option if the 28nm DSI PHY is used on the platform.

config DRM_MSM_DSI_20NM_PHY
	bool "Enable DSI 20nm PHY driver in MSM DRM"
	depends on DRM_MSM_DSI
	default y
	help
	  Choose this option if the 20nm DSI PHY is used on the platform.

config DRM_MSM_DSI_28NM_8960_PHY
	bool "Enable DSI 28nm 8960 PHY driver in MSM DRM"
	depends on DRM_MSM_DSI
	default y
	help
	  Choose this option if the 28nm DSI PHY 8960 variant is used on the
	  platform.

config DRM_MSM_DSI_14NM_PHY
	bool "Enable DSI 14nm PHY driver in MSM DRM (used by MSM8996/APQ8096)"
	depends on DRM_MSM_DSI
	default y
	help
	  Choose this option if DSI PHY on 8996 is used on the platform.

config DRM_MSM_DSI_10NM_PHY
	bool "Enable DSI 10nm PHY driver in MSM DRM (used by SDM845)"
	depends on DRM_MSM_DSI
	default y
	help
	  Choose this option if DSI PHY on SDM845 is used on the platform.

config DRM_MSM_DSI_7NM_PHY
	bool "Enable DSI 7nm PHY driver in MSM DRM"
	depends on DRM_MSM_DSI
	default y
	help
	  Choose this option if DSI PHY on SM8150/SM8250/SC7280 is used on
	  the platform.

config DRM_MSM_HDMI
	bool "Enable HDMI support in MSM DRM driver"
	depends on DRM_MSM
	default y
	help
	  Compile in support for the HDMI output MSM DRM driver. It can
	  be a primary or a secondary display on device. Note that this is used
	  only for the direct HDMI output. If the device outputs HDMI data
	  throught some kind of DSI-to-HDMI bridge, this option can be disabled.

config DRM_MSM_HDMI_HDCP
	bool "Enable HDMI HDCP support in MSM DRM driver"
	depends on DRM_MSM && DRM_MSM_HDMI
	default y
	help
	  Choose this option to enable HDCP state machine
```

## panel/Kconfig
```kconfig
config DRM_PANEL_SAMSUNG_SOFEF00
	tristate "Samsung sofef00/s6e3fc2x01 OnePlus 6/6T DSI cmd mode panels"
	depends on OF
	depends on DRM_MIPI_DSI
	depends on BACKLIGHT_CLASS_DEVICE
	select VIDEOMODE_HELPERS
	help
	  Say Y or M here if you want to enable support for the Samsung AMOLED
	  command mode panels found in the OnePlus 6/6T smartphones.

	  The panels are 2280x1080@60Hz and 2340x1080@60Hz respectively
endmenu
```
