#include "sdm845-oneplus-common.dtsi"
#include "fajita.dtsi"
#include "fajita-pvt.dtsi"

/ {
    model = "Qualcomm Technologies, Inc. SDM845 v2.1 MTP PVT/MP";
    compatible = "qcom,sdm845-mtp", "qcom,sdm845", "qcom,mtp";
    qcom,msm-id = <321 0x20001>;
    qcom,board-id = <8 0 18801 41>;
    oem,project-id = <18801>;
    oem,hw-id = <41>;

};

&display_panel {
	status = "okay";
	compatible = "samsung,s6e3fc2x01";
};

&framebuffer {
	height = <2340>;
};

/*
 * Disable the panel (if needed.)
*/

DISABLE_NODE(dsi_samsung_s6e3fc2x01_cmd);
