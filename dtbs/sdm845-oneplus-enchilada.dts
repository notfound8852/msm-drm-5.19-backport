#include "sdm845-oneplus-common.dtsi"
#include "enchilada.dtsi"
#include "enchilada-pvt.dtsi"

/ {
    model = "Qualcomm Technologies, Inc. SDM845 v2.1 MTP PVT";
    compatible = "qcom,sdm845-mtp", "qcom,sdm845", "qcom,mtp";
    qcom,msm-id = <321 0x20001>;
    qcom,board-id = <8 0 17819 22>;
    oem,project-id = <17819>;
    oem,hw-id = <22>;
};

&display_panel {
    status = "okay";
    compatible = "samsung,sofef00";
};

/*
 * Disable the panel (if needed.)
*/

DISABLE_NODE(dsi_samsung_sofef00_m_cmd);
